## conf/layer.conf
```bitbake
# We have a conf and classes directory, append to BBPATH
BBPATH .= ":${LAYERDIR}"

BBFILES += "${LAYERDIR}/recipes-*/*/*.bb"

CLOSED_LICENSE_DIR := '${@os.path.normpath("${LAYERDIR}/files/licenses")}'
```
